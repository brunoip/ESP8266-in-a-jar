
#include <SPI.h>
#include <Wire.h>
#include <Adafruit_GFX.h>
#include <Adafruit_SSD1306.h>

#define SCREEN_WIDTH 128 // OLED display width, in pixels
#define SCREEN_HEIGHT 32 // OLED display height, in pixels

// Declaration for an SSD1306 display connected to I2C (SDA, SCL pins)
#define OLED_RESET     -1 // Reset pin # (or -1 if sharing Arduino reset pin)
Adafruit_SSD1306 display(SCREEN_WIDTH, SCREEN_HEIGHT, &Wire, OLED_RESET);

const int UVOUT = A0; //Output from the UV sensor

const int WindSensorPin = D4;


// 'Sun', 32x16px
const unsigned char WeatherBitmap1 [] PROGMEM = {
  0x00, 0x00, 0x00, 0x00, 0x00, 0x00, 0x00, 0x00, 0x00, 0x01, 0x00, 0x00, 0x00, 0x21, 0x08, 0x00, 
  0x00, 0x10, 0x10, 0x00, 0x00, 0x03, 0x80, 0x00, 0x00, 0x04, 0x40, 0x00, 0x00, 0x08, 0x20, 0x00, 
  0x00, 0x68, 0x2c, 0x00, 0x00, 0x08, 0x20, 0x00, 0x00, 0x04, 0x40, 0x00, 0x00, 0x03, 0x80, 0x00, 
  0x00, 0x10, 0x10, 0x00, 0x00, 0x21, 0x08, 0x00, 0x00, 0x01, 0x00, 0x00, 0x00, 0x00, 0x00, 0x00
};
// 'Wind', 32x16px
const unsigned char WeatherBitmap2 [] PROGMEM = {
  0x00, 0x00, 0x00, 0x00, 0x00, 0x00, 0x0c, 0x00, 0x00, 0x00, 0x12, 0x00, 0x00, 0x00, 0x21, 0x00, 
  0x00, 0x00, 0x01, 0x00, 0x00, 0x38, 0x02, 0x00, 0x00, 0x44, 0xfc, 0x00, 0x03, 0x82, 0x00, 0xc8, 
  0x04, 0x81, 0xff, 0x30, 0x08, 0x44, 0x00, 0x00, 0x08, 0x03, 0xfe, 0x00, 0x04, 0x00, 0x01, 0x00, 
  0x03, 0xff, 0x80, 0x80, 0x00, 0x00, 0x00, 0x80, 0x00, 0x00, 0x01, 0x00, 0x00, 0x00, 0x00, 0x00
};
// 'Light', 32x16px
const unsigned char WeatherBitmap3 [] PROGMEM = {
  0x00, 0x00, 0x00, 0x00, 0x00, 0x03, 0xe0, 0x00, 0x00, 0x04, 0x10, 0x00, 0x00, 0x08, 0x08, 0x00, 
  0x00, 0x10, 0x04, 0x00, 0x00, 0x11, 0xc4, 0x00, 0x00, 0x12, 0x24, 0x00, 0x00, 0x11, 0x44, 0x00, 
  0x00, 0x09, 0x48, 0x00, 0x00, 0x05, 0x50, 0x00, 0x00, 0x03, 0xe0, 0x00, 0x00, 0x02, 0x20, 0x00, 
  0x00, 0x02, 0x20, 0x00, 0x00, 0x03, 0x60, 0x00, 0x00, 0x01, 0xc0, 0x00, 0x00, 0x00, 0x00, 0x00
};

// 'Mill', 32x32px
const unsigned char WeatherBitmap4 [] PROGMEM = {
  0x00, 0x00, 0x00, 0x00, 0x00, 0x30, 0x00, 0x00, 0x00, 0x28, 0x00, 0x00, 0x00, 0x24, 0x00, 0x00, 
  0x00, 0x24, 0x00, 0x00, 0x00, 0x22, 0x00, 0x00, 0x00, 0x22, 0x00, 0x00, 0x00, 0x21, 0x00, 0x00, 
  0x00, 0x11, 0x00, 0x00, 0x00, 0x11, 0x00, 0x00, 0x00, 0x09, 0x00, 0x00, 0x00, 0x09, 0x00, 0x00, 
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  0x00, 0x02, 0x80, 0x00, 0x00, 0x02, 0x80, 0x00, 0x00, 0x02, 0x80, 0x00, 0x00, 0x07, 0xc0, 0x00
};


float uvIntensity = 0;
int uvLevel = 0;

float LastUvIntensity = 0;
int LastUvLevel = 0;

int readUV=0;

//set metric = false to use miles
boolean metric = true;
//anenometer circumference in centimeters 
float AnemometerCircunference = 2 * 3.14 * 5.5;

float WindSpeed = 0.0;
float LastWindSpeed = 0.0;
long WindSensorTime = 0;
long WindSensorTimeDelta = 0;
boolean WindSensorOn = true;

bool ceroSpeed=false;

void setup() {
  
  pinMode(UVOUT, INPUT);
  pinMode(WindSensorPin, INPUT);
  
  Serial.begin(115200);
  if(!display.begin(SSD1306_SWITCHCAPVCC, 0x3C)) {
    Serial.println(F("SSD1306 allocation failed"));
    for(;;);
  }
  
  drawSplashScreen();
  delay(2200);
}

void loop() {

  readUV++;
  if(readUV>10){
    readUVSensor();
    readUV=0;
  }
  
  checkWindSensor();
  
 if((LastWindSpeed != WindSpeed) || (LastUvIntensity != uvIntensity) || (LastUvLevel != uvLevel) )
    drawScreen();
 
  ceroSpeed=((millis() - WindSensorTime)/100)>10;
  delay (5);
}

void checkWindSensor()
{
  int r = digitalRead(WindSensorPin);

  if(r == 0 && WindSensorOn == true)
  {
    WindSensorOn = false;
    WindSensorTimeDelta = millis() - WindSensorTime;
    WindSensorTime = millis();
    ceroSpeed=false;
  }
  else if (r == 1 && WindSensorOn == false)
  WindSensorOn = true;
  
  LastWindSpeed=WindSpeed;
  WindSpeed = ( (AnemometerCircunference) / (WindSensorTimeDelta )) * (metric?36:22.369); 
  if(ceroSpeed)
      WindSpeed=0;
}


void readUVSensor(){

  LastUvIntensity = uvIntensity;
  LastUvLevel = uvLevel;
  
  uvLevel = averageAnalogRead(UVOUT);
  float outputVoltage = (3.3  * uvLevel) / 1023;

  //Convert the voltage to a UV intensity level
  uvIntensity = mapfloat(outputVoltage, 0.99, 2.8, 0.0, 15.0); 
}

void drawScreen(){
  
  display.clearDisplay();
  display.setRotation( 3);

  display.setTextSize(1); 
  display.setTextColor(WHITE);
  
  display.setCursor(6, 20);
  display.print(uvLevel);

  display.setCursor(4, 62);
  display.print(uvIntensity);

  display.setCursor(4, 104);

  if(WindSpeed>10)
    display.print(WindSpeed,1);
  else
    display.print(WindSpeed);

  // Draw the icons
  display.drawBitmap(0, 0, WeatherBitmap1, 32, 16, 1);
  display.drawBitmap(0, 44, WeatherBitmap3, 32, 16, 1);
  display.drawBitmap(0, 84, WeatherBitmap2, 32, 16, 1);
  display.display();
}

void drawSplashScreen(){
  
  display.clearDisplay();
  display.setRotation( 3);

  display.setTextSize(1); 
  display.setTextColor(WHITE);
 
  display.setCursor(1, 66);
  display.print("bruno");
  display.setCursor(10, 80);
  display.print("ip");

  display.setCursor(4, 96);
  display.print("2020");

  display.drawBitmap(0, 28, WeatherBitmap4, 32, 32, 1);
  display.display();
}

int averageAnalogRead(int pinToRead)
{
  byte numberOfReadings = 8;
  unsigned int runningValue = 0; 

  for(int x = 0 ; x < numberOfReadings ; x++)
    runningValue += analogRead(pinToRead);
  runningValue /= numberOfReadings;

  return(runningValue);  
}

//The Arduino Map function but for floats
//From: http://forum.arduino.cc/index.php?topic=3922.0
float mapfloat(float x, float in_min, float in_max, float out_min, float out_max)
{
  return (x - in_min) * (out_max - out_min) / (in_max - in_min) + out_min;
}
